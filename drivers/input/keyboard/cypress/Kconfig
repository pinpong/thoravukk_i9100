## drivers/input/keyboard/cypress/Kconfig
```kconfig
#
# Cypress touchkey configuration
#

config KEYBOARD_CYPRESS_TOUCH
	tristate "Cypress touchkey support"
	help
	  Say Y here to enable the cypress touchkey.

	  To compile this driver as a module, choose M here.

config TARGET_CM_KERNEL
	bool "For CM/AOSP/AOKP Roms - with BLN support"
	help
	  CM Roms BLN support.
	  To compile this driver as a module, choose M here.
```
